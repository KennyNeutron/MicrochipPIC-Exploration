ORG 0X6000
FONT0_0
			MOVLW	0
			MOVWF	PCLATU,0
			MOVLW	0X60
			MOVWF	PCLATH,0

			MOVFF	BTCOUNT,WREG
			BCF		STATUS,C


			ADDWF	PCL,1,0
			DT	B'10001111'
			DT	B'01110111'
			DT	B'01110111'
			DT	B'01110111'
			DT	B'01110111'
			DT	B'01110111'
			DT	B'10001111'
			DT	B'11111111'
			DT	B'11111111'

FONT1_0
			MOVLW	0
			MOVWF	PCLATU,0
			MOVLW	0X60
			MOVWF	PCLATH,0

			MOVFF	BTCOUNT,WREG
			BCF		STATUS,C


			ADDWF	PCL,1,0
			DT	B'11111111'
			DT	B'11000111'
			DT	B'10000011'
			DT	B'00111001'
			DT	B'00111001'
			DT	B'00111001'
			DT	B'00111001'	
			DT	B'00111001'
			DT	B'00111001'
			DT	B'00111001'
			DT	B'00111001'
			DT	B'00111001'
			DT	B'00111001'
			DT	B'00111001'
			DT	B'10000011'
			DT	B'11000111'

FONT2_0
			MOVLW	0
			MOVWF	PCLATU,0
			MOVLW	0X60
			MOVWF	PCLATH,0

			MOVFF	BTCOUNT,WREG
			BCF		STATUS,C
			RLCF	WREG

		
			ADDWF	PCL,1,0
			DT	B'11111111',B'11111111'
			DT	B'11000000',B'11111111'
			DT	B'10000000',B'01111111'
			DT	B'00011110',B'00111111'
			DT	B'00111111',B'00111111'
			DT	B'00111111',B'00111111'
			DT	B'00111111',B'00111111'
			DT	B'00111111',B'00111111'
			DT	B'00111111',B'00111111'
			DT	B'00111111',B'00111111'
			DT	B'00111111',B'00111111'
			DT	B'00111111',B'00111111'
			DT	B'00111111',B'00111111'
			DT	B'00011110',B'00111111'
			DT	B'10000000',B'01111111'
			DT	B'11000000',B'11111111'





ORG	0X6100
FONT0_1
			MOVLW	0
			MOVWF	PCLATU,0
			MOVLW	0X61
			MOVWF	PCLATH,0

			MOVFF	BTCOUNT,WREG
			BCF		STATUS,C


			ADDWF	PCL,1,0
			DT	B'10111111'
			DT	B'00111111'
			DT	B'10111111'
			DT	B'10111111'
			DT	B'10111111'
			DT	B'10111111'
			DT	B'00011111'
			DT	B'11111111'
			DT	B'11111111'
FONT1_1
			MOVLW	0
			MOVWF	PCLATU,0
			MOVLW	0X61
			MOVWF	PCLATH,0

			MOVFF	BTCOUNT,WREG
			BCF		STATUS,C


			ADDWF	PCL,1,0
			DT	B'11111111'
			DT	B'11001111'
			DT	B'11001111'
			DT	B'10001111'
			DT	B'00001111'
			DT	B'01001111'
			DT	B'11001111'
			DT	B'11001111'
			DT	B'11001111'
			DT	B'11001111'
			DT	B'11001111'
			DT	B'11001111'
			DT	B'11001111'
			DT	B'11001111'
			DT	B'00000011'
			DT	B'00000011'
FONT2_1
			MOVLW	0
			MOVWF	PCLATU,0
			MOVLW	0X61
			MOVWF	PCLATH,0

			MOVFF	BTCOUNT,WREG
			BCF		STATUS,C
			RLCF	WREG

		
			ADDWF	PCL,1,0
			DT	B'11111111',B'11111111';BTC=00
			DT	B'11100111',B'11111111';BTC=01
			DT	B'11100111',B'11111111';BTC=02
			DT	B'11000111',B'11111111';BTC=03
			DT	B'10000111',B'11111111';BTC=04
			DT	B'00100111',B'11111111';BTC=05
			DT	B'11100111',B'11111111';BTC=06
			DT	B'11100111',B'11111111';BTC=07
			DT	B'11100111',B'11111111';BTC=08
			DT	B'11100111',B'11111111';BTC=09
			DT	B'11100111',B'11111111';BTC=0A
			DT	B'11100111',B'11111111';BTC=0B
			DT	B'11100111',B'11111111';BTC=0C
			DT	B'11100111',B'11111111';BTC=0D
			DT	B'00000000',B'11111111';BTC=0E
			DT	B'00000000',B'11111111';BTC=0F




ORG	0X6200
FONT0_2
			MOVLW	0
			MOVWF	PCLATU,0
			MOVLW	0X62
			MOVWF	PCLATH,0

			MOVFF	BTCOUNT,WREG
			BCF		STATUS,C


			ADDWF	PCL,1,0
			DT	B'10001111'
			DT	B'01110111'
			DT	B'11110111'
			DT	B'10001111'
			DT	B'01111111'
			DT	B'01110111'
			DT	B'00000111'
			DT	B'11111111'
			DT	B'11111111'
FONT1_2
			MOVLW	0
			MOVWF	PCLATU,0
			MOVLW	0X62
			MOVWF	PCLATH,0

			MOVFF	BTCOUNT,WREG
			BCF		STATUS,C


			ADDWF	PCL,1,0
			DT	B'11111111'
			DT	B'11000011'
			DT	B'10000001'
			DT	B'00111001'
			DT	B'11111001'
			DT	B'11111001'
			DT	B'11111001'
			DT	B'11111001'
			DT	B'10000001'
			DT	B'00000011'
			DT	B'00111111'
			DT	B'00111111'
			DT	B'00111111'
			DT	B'00111001'
			DT	B'00000001'
			DT	B'00000001'

FONT2_2
			MOVLW	0
			MOVWF	PCLATU,0
			MOVLW	0X62
			MOVWF	PCLATH,0

			MOVFF	BTCOUNT,WREG
			BCF		STATUS,C
			RLCF	WREG

		
			ADDWF	PCL,1,0
			DT	B'11111111',B'11111111'	;BTC=0F
			DT	B'11000000',B'11111111'	;BTC=00
			DT	B'10000000',B'01111111'	;BTC=01
			DT	B'00111110',B'00111111'	;BTC=02
			DT	B'11111111',B'00111111'	;BTC=03
			DT	B'11111111',B'00111111'	;BTC=04
			DT	B'11111111',B'00111111'	;BTC=05
			DT	B'11111110',B'00111111'	;BTC=06
			DT	B'11000000',B'01111111'	;BTC=07
			DT	B'10000000',B'11111111'	;BTC=08
			DT	B'00011111',B'11111111'	;BTC=09
			DT	B'00111111',B'11111111'	;BTC=0A
			DT	B'00111111',B'11111111'	;BTC=0B
			DT	B'00111111',B'00111111'	;BTC=0C
			DT	B'00000000',B'00111111'	;BTC=0D
			DT	B'00000000',B'00111111'	;BTC=0E



ORG	0X6300
FONT0_3
			MOVLW	0
			MOVWF	PCLATU,0
			MOVLW	0X63
			MOVWF	PCLATH,0

			MOVFF	BTCOUNT,WREG
			BCF		STATUS,C


			ADDWF	PCL,1,0
			DT	B'10001111'
			DT	B'01110111'
			DT	B'11110111'
			DT	B'10001111'
			DT	B'11110111'
			DT	B'01110111'
			DT	B'10001111'
			DT	B'11111111'
			DT	B'11111111'
FONT1_3
			MOVLW	0
			MOVWF	PCLATU,0
			MOVLW	0X63
			MOVWF	PCLATH,0

			MOVFF	BTCOUNT,WREG
			BCF		STATUS,C


			ADDWF	PCL,1,0
			DT	B'11111111'
			DT	B'00000011'
			DT	B'00000001'
			DT	B'11111001'
			DT	B'11111001'
			DT	B'11111001'
			DT	B'11111001'
			DT	B'10000011'
			DT	B'10000011'
			DT	B'11111001'
			DT	B'11111001'
			DT	B'11111001'
			DT	B'11111001'
			DT	B'11111001'
			DT	B'00000001'
			DT	B'00000011'
FONT2_3
			MOVLW	0
			MOVWF	PCLATU,0
			MOVLW	0X63
			MOVWF	PCLATH,0

			MOVFF	BTCOUNT,WREG
			BCF		STATUS,C
			RLCF	WREG

		
			ADDWF	PCL,1,0
			DT	B'11111111',B'11111111'	;BTC=0F
			DT	B'11000000',B'11111111'	;BTC=00
			DT	B'10000000',B'01111111'	;BTC=01
			DT	B'00011110',B'00111111'	;BTC=02
			DT	B'00111111',B'00111111'	;BTC=03
			DT	B'11111111',B'00111111'	;BTC=04
			DT	B'11111111',B'00111111'	;BTC=05
			DT	B'11111110',B'00111111'	;BTC=06
			DT	B'11100000',B'01111111'	;BTC=07
			DT	B'11100000',B'01111111'	;BTC=08
			DT	B'11111110',B'00111111'	;BTC=09
			DT	B'11111111',B'00111111'	;BTC=0A
			DT	B'00111111',B'00111111'	;BTC=0B
			DT	B'00011110',B'00111111'	;BTC=0C
			DT	B'10000000',B'01111111'	;BTC=0D
			DT	B'11000000',B'11111111'	;BTC=0E





ORG	0X6400
FONT0_4
			MOVLW	0
			MOVWF	PCLATU,0
			MOVLW	0X64
			MOVWF	PCLATH,0

			MOVFF	BTCOUNT,WREG
			BCF		STATUS,C


			ADDWF	PCL,1,0
			DT	B'11101111'
			DT	B'11001111'
			DT	B'10101111'
			DT	B'01101111'
			DT	B'00000111'
			DT	B'11101111'
			DT	B'11101111'
			DT	B'11111111'
			DT	B'11111111'
FONT1_4
			MOVLW	0
			MOVWF	PCLATU,0
			MOVLW	0X64
			MOVWF	PCLATH,0

			MOVFF	BTCOUNT,WREG
			BCF		STATUS,C


			ADDWF	PCL,1,0
			DT	B'11111111'
			DT	B'11111001'
			DT	B'11111001'
			DT	B'11111001'
			DT	B'11110001'
			DT	B'11100001'
			DT	B'11001001'
			DT	B'10011001'
			DT	B'00111001'
			DT	B'00111001'
			DT	B'00000001'
			DT	B'00000001'
			DT	B'11111001'
			DT	B'11111001'
			DT	B'11111001'
			DT	B'11111001'

FONT2_4
			MOVLW	0
			MOVWF	PCLATU,0
			MOVLW	0X64
			MOVWF	PCLATH,0

			MOVFF	BTCOUNT,WREG
			BCF		STATUS,C
			RLCF	WREG

		
			ADDWF	PCL,1,0
			DT	B'11111111',B'11111111'	;BTC=0F
			DT	B'11111111',B'10111111'	;BTC=00
			DT	B'11111101',B'00111111'	;BTC=01
			DT	B'11111001',B'00111111'	;BTC=02
			DT	B'11111001',B'00111111'	;BTC=03
			DT	B'11110011',B'00111111'	;BTC=04
			DT	B'11100111',B'00111111'	;BTC=05
			DT	B'11001111',B'00111111'	;BTC=06
			DT	B'10011111',B'00111111'	;BTC=07
			DT	B'00111111',B'00111111'	;BTC=08
			DT	B'00000000',B'00111111'	;BTC=09
			DT	B'00000000',B'00111111'	;BTC=0A
			DT	B'11111111',B'00111111'	;BTC=0B
			DT	B'11111111',B'00111111'	;BTC=0C
			DT	B'11111111',B'00111111'	;BTC=0D
			DT	B'11111111',B'01111111'	;BTC=0E



ORG	0X6500
FONT0_5
			MOVLW	0
			MOVWF	PCLATU,0
			MOVLW	0X65
			MOVWF	PCLATH,0

			MOVFF	BTCOUNT,WREG
			BCF		STATUS,C


			ADDWF	PCL,1,0
			DT	B'00000111'	
			DT	B'01111111'	
			DT	B'01111111'	
			DT	B'00001111'	
			DT	B'11110111'	
			DT	B'11110111'	
			DT	B'00001111'	
			DT	B'11111111'	
			DT	B'11111111'
FONT1_5
			MOVLW	0
			MOVWF	PCLATU,0
			MOVLW	0X65
			MOVWF	PCLATH,0

			MOVFF	BTCOUNT,WREG
			BCF		STATUS,C


			ADDWF	PCL,1,0
			DT	B'11111111'
			DT	B'00000001'
			DT	B'00000001'
			DT	B'00111111'
			DT	B'00111111'
			DT	B'00111111'
			DT	B'00111111'
			DT	B'00000011'
			DT	B'00000001'
			DT	B'11111001'
			DT	B'11111001'
			DT	B'11111001'
			DT	B'11111001'
			DT	B'11111001'
			DT	B'00000001'
			DT	B'00000011'

FONT2_5
			MOVLW	0
			MOVWF	PCLATU,0
			MOVLW	0X65
			MOVWF	PCLATH,0

			MOVFF	BTCOUNT,WREG
			BCF		STATUS,C
			RLCF	WREG

		
			ADDWF	PCL,1,0
			DT	B'11111111',B'11111111'	;BTC=0F
			DT	B'00000000',B'00111111'	;BTC=00
			DT	B'00000000',B'00111111'	;BTC=01
			DT	B'00111111',B'01111111'	;BTC=02
			DT	B'00111111',B'11111111'	;BTC=03
			DT	B'00111111',B'11111111'	;BTC=04
			DT	B'00111111',B'11111111'	;BTC=05
			DT	B'00000000',B'11111111'	;BTC=06
			DT	B'00000000',B'01111111'	;BTC=07
			DT	B'11111110',B'00111111'	;BTC=08
			DT	B'11111111',B'00111111'	;BTC=09
			DT	B'11111111',B'00111111'	;BTC=0A
			DT	B'00111111',B'00111111'	;BTC=0B
			DT	B'00011110',B'00111111'	;BTC=0C
			DT	B'10000000',B'01111111'	;BTC=0D
			DT	B'11000000',B'11111111'	;BTC=0E


ORG	0X6600
FONT0_6
			MOVLW	0
			MOVWF	PCLATU,0
			MOVLW	0X66
			MOVWF	PCLATH,0

			MOVFF	BTCOUNT,WREG
			BCF		STATUS,C


			ADDWF	PCL,1,0
			DT	B'10001111'	
			DT	B'01110111'	
			DT	B'01111111'	
			DT	B'00001111'	
			DT	B'01110111'	
			DT	B'01110111'	
			DT	B'10001111'	
			DT	B'11111111'	
			DT	B'11111111'	

FONT1_6
			MOVLW	0
			MOVWF	PCLATU,0
			MOVLW	0X66
			MOVWF	PCLATH,0

			MOVFF	BTCOUNT,WREG
			BCF		STATUS,C


			ADDWF	PCL,1,0
			DT	B'11111111'
			DT	B'10000011'
			DT	B'00000001'
			DT	B'00111001'
			DT	B'00111111'
			DT	B'00111111'
			DT	B'00111111'
			DT	B'00111111'
			DT	B'00000011'
			DT	B'00000001'
			DT	B'00111001'
			DT	B'00111001'
			DT	B'00111001'
			DT	B'00111001'
			DT	B'00000001'
			DT	B'10000011'

FONT2_6
			MOVLW	0
			MOVWF	PCLATU,0
			MOVLW	0X66
			MOVWF	PCLATH,0

			MOVFF	BTCOUNT,WREG
			BCF		STATUS,C
			RLCF	WREG

		
			ADDWF	PCL,1,0
			DT	B'11111111',B'11111111'	;BTC=0F
			DT	B'11000000',B'01111111'	;BTC=00
			DT	B'10000000',B'00111111'	;BTC=01
			DT	B'00011110',B'00111111'	;BTC=02
			DT	B'00111111',B'00111111'	;BTC=03
			DT	B'00111111',B'11111111'	;BTC=04
			DT	B'00011111',B'11111111'	;BTC=05
			DT	B'00000000',B'11111111'	;BTC=06
			DT	B'00000000',B'01111111'	;BTC=07
			DT	B'00011110',B'00111111'	;BTC=08
			DT	B'00111111',B'00111111'	;BTC=09
			DT	B'00111111',B'00111111'	;BTC=0A
			DT	B'00111111',B'00111111'	;BTC=0B
			DT	B'00011110',B'00111111'	;BTC=0C
			DT	B'10000000',B'01111111'	;BTC=0D
			DT	B'11000000',B'11111111'	;BTC=0E


ORG	0X6700
FONT0_7
			MOVLW	0
			MOVWF	PCLATU,0
			MOVLW	0X67
			MOVWF	PCLATH,0

			MOVFF	BTCOUNT,WREG
			BCF		STATUS,C


			ADDWF	PCL,1,0
			DT	B'00000111'	
			DT	B'11110111'	
			DT	B'11101111'	
			DT	B'11011111'	
			DT	B'11011111'	
			DT	B'11011111'	
			DT	B'11011111'	
			DT	B'11111111'	
			DT	B'11111111'	
FONT1_7
			MOVLW	0
			MOVWF	PCLATU,0
			MOVLW	0X67
			MOVWF	PCLATH,0

			MOVFF	BTCOUNT,WREG
			BCF		STATUS,C


			ADDWF	PCL,1,0
			DT	B'11111111'
			DT	B'00000001'
			DT	B'00000001'
			DT	B'11111001'
			DT	B'11111001'
			DT	B'11111001'
			DT	B'11110011'
			DT	B'11100111'
			DT	B'11100111'
			DT	B'11100111'
			DT	B'11100111'
			DT	B'11100111'
			DT	B'11100111'
			DT	B'11100111'
			DT	B'11100111'
			DT	B'11100111'


FONT2_7
			MOVLW	0
			MOVWF	PCLATU,0
			MOVLW	0X67
			MOVWF	PCLATH,0

			MOVFF	BTCOUNT,WREG
			BCF		STATUS,C
			RLCF	WREG

		
			ADDWF	PCL,1,0
			DT	B'11111111',B'11111111'	;BTC=0F
			DT	B'00000000',B'00111111' ;BTC=00
			DT	B'00000000',B'00111111' ;BTC=01
			DT	B'00111111',B'00111111' ;BTC=02
			DT	B'00111111',B'00111111' ;BTC=03
			DT	B'11111111',B'00111111' ;BTC=04
			DT	B'11111110',B'00111111' ;BTC=05
			DT	B'11111100',B'01111111' ;BTC=06
			DT	B'11111000',B'11111111' ;BTC=07
			DT	B'11110001',B'11111111' ;BTC=08
			DT	B'11100011',B'11111111' ;BTC=09
			DT	B'11100111',B'11111111' ;BTC=0A
			DT	B'11100111',B'11111111' ;BTC=0B
			DT	B'11100111',B'11111111' ;BTC=0C
			DT	B'11100111',B'11111111' ;BTC=0D
			DT	B'11100111',B'11111111' ;BTC=0E



ORG	0X6800
FONT0_8
			MOVLW	0
			MOVWF	PCLATU,0
			MOVLW	0X68
			MOVWF	PCLATH,0

			MOVFF	BTCOUNT,WREG
			BCF		STATUS,C


			ADDWF	PCL,1,0
			DT	B'10001111'	
			DT	B'01110111'	
			DT	B'01110111'	
			DT	B'10001111'	
			DT	B'01110111'	
			DT	B'01110111'	
			DT	B'10001111'	
			DT	B'11111111'	
			DT	B'11111111'	
FONT1_8
			MOVLW	0
			MOVWF	PCLATU,0
			MOVLW	0X68
			MOVWF	PCLATH,0

			MOVFF	BTCOUNT,WREG
			BCF		STATUS,C


			ADDWF	PCL,1,0
			DT	B'11111111'
			DT	B'10000011'
			DT	B'00000001'
			DT	B'00111001'
			DT	B'00111001'
			DT	B'00111001'
			DT	B'00111001'
			DT	B'00111001'
			DT	B'10000011'
			DT	B'00000001'
			DT	B'00111001'
			DT	B'00111001'
			DT	B'00111001'
			DT	B'00111001'
			DT	B'00000001'
			DT	B'10000011'

FONT2_8
			MOVLW	0
			MOVWF	PCLATU,0
			MOVLW	0X68
			MOVWF	PCLATH,0

			MOVFF	BTCOUNT,WREG
			BCF		STATUS,C
			RLCF	WREG

		
			ADDWF	PCL,1,0
			DT	B'11111111',B'11111111'	;BTC=0F
			DT	B'11000000',B'11111111'	;BTC=00
			DT	B'10000000',B'01111111'	;BTC=01
			DT	B'00011110',B'00111111'	;BTC=02
			DT	B'00111111',B'00111111'	;BTC=03
			DT	B'00111111',B'00111111'	;BTC=04
			DT	B'00011110',B'00111111'	;BTC=05
			DT	B'10000000',B'01111111'	;BTC=06
			DT	B'10000000',B'01111111'	;BTC=07
			DT	B'00011110',B'00111111'	;BTC=08
			DT	B'00111111',B'00111111'	;BTC=09
			DT	B'00111111',B'00111111'	;BTC=0A
			DT	B'00111111',B'00111111'	;BTC=0B
			DT	B'00011110',B'00111111'	;BTC=0C
			DT	B'10000000',B'01111111'	;BTC=0D
			DT	B'11000000',B'11111111'	;BTC=0E



ORG	0X6900
FONT0_9
			MOVLW	0
			MOVWF	PCLATU,0
			MOVLW	0X69
			MOVWF	PCLATH,0

			MOVFF	BTCOUNT,WREG
			BCF		STATUS,C


			ADDWF	PCL,1,0
			DT	B'10001111'	
			DT	B'01110111'	
			DT	B'01110111'	
			DT	B'10000111'	
			DT	B'11110111'	
			DT	B'01110111'	
			DT	B'10001111'	
			DT	B'11111111'	
			DT	B'11111111'	
FONT1_9
			MOVLW	0
			MOVWF	PCLATU,0
			MOVLW	0X69
			MOVWF	PCLATH,0

			MOVFF	BTCOUNT,WREG
			BCF		STATUS,C


			ADDWF	PCL,1,0
			DT	B'11111111'
			DT	B'10000011'
			DT	B'00000001'
			DT	B'00111001'
			DT	B'00111001'
			DT	B'00111001'
			DT	B'00111001'
			DT	B'00111001'
			DT	B'00000001'
			DT	B'10000001'
			DT	B'11111001'
			DT	B'11111001'
			DT	B'11111001'
			DT	B'00111001'
			DT	B'00000001'
			DT	B'10000011'
FONT2_9
			MOVLW	0
			MOVWF	PCLATU,0
			MOVLW	0X69
			MOVWF	PCLATH,0

			MOVFF	BTCOUNT,WREG
			BCF		STATUS,C
			RLCF	WREG

		
			ADDWF	PCL,1,0
			DT	B'11111111',B'11111111'	;BTC=0F
			DT	B'11000000',B'11111111'	;BTC=00
			DT	B'10000000',B'01111111'	;BTC=01
			DT	B'00011110',B'00111111'	;BTC=02
			DT	B'00111111',B'00111111'	;BTC=03
			DT	B'00111111',B'00111111'	;BTC=04
			DT	B'00111111',B'00111111'	;BTC=05
			DT	B'00011110',B'00111111'	;BTC=06
			DT	B'10000000',B'00111111'	;BTC=07
			DT	B'11000000',B'00111111'	;BTC=08
			DT	B'11111110',B'00111111'	;BTC=09
			DT	B'11111111',B'00111111'	;BTC=0A
			DT	B'00111111',B'00111111'	;BTC=0B
			DT	B'00011110',B'00111111'	;BTC=0C
			DT	B'10000000',B'01111111'	;BTC=0D
			DT	B'11000000',B'11111111'	;BTC=0E


ORG	0X6A00
FONT1_A
			MOVLW	0
			MOVWF	PCLATU,0
			MOVLW	0X6A
			MOVWF	PCLATH,0

			MOVFF	BTCOUNT,WREG
			BCF		STATUS,C


			ADDWF	PCL,1,0
			DT	B'11111111'
			DT	B'11111111'
			DT	B'11111111'
			DT	B'11111111'
			DT	B'11111111'
			DT	B'11111111'
			DT	B'11111111'
			DT	B'11111111'
			DT	B'11111111'
			DT	B'11111111'
			DT	B'11111111'
			DT	B'11111111'
			DT	B'11111111'
			DT	B'11111111'
			DT	B'11111111'
			DT	B'11111111'
FONT2_A
			MOVLW	0
			MOVWF	PCLATU,0
			MOVLW	0X6A
			MOVWF	PCLATH,0

			MOVFF	BTCOUNT,WREG
			BCF		STATUS,C
			RLCF	WREG

		
			ADDWF	PCL,1,0
			DT	B'11111111',B'11111111'	;BTC=00
			DT	B'11111111',B'11111111'	;BTC=01
			DT	B'11111111',B'11111111'	;BTC=02
			DT	B'11111111',B'11111111'	;BTC=03
			DT	B'11111111',B'11111111'	;BTC=04
			DT	B'11111111',B'11111111'	;BTC=05
			DT	B'11111111',B'11111111'	;BTC=06
			DT	B'11111111',B'11111111'	;BTC=07
			DT	B'11111111',B'11111111'	;BTC=08
			DT	B'11111111',B'11111111'	;BTC=09
			DT	B'11111111',B'11111111'	;BTC=0A
			DT	B'11111111',B'11111111'	;BTC=0B
			DT	B'11111111',B'11111111'	;BTC=0C
			DT	B'11111111',B'11111111'	;BTC=0D
			DT	B'11111111',B'11111111'	;BTC=0E
			DT	B'11111111',B'11111111'	;BTC=0F


ORG	0X6B00
FONT1_B
			MOVLW	0
			MOVWF	PCLATU,0
			MOVLW	0X6B
			MOVWF	PCLATH,0

			MOVFF	BTCOUNT,WREG
			BCF		STATUS,C


			ADDWF	PCL,1,0
			DT	B'11111111'	;00
			DT	B'11111111'	;01
			DT	B'11111111'	;02
			DT	B'10011111'	;03
			DT	B'10011111'	;04
			DT	B'11111111'	;05
			DT	B'11111111'	;06
			DT	B'11111111'	;07
			DT	B'11111111'	;08
			DT	B'11111111'	;09
			DT	B'11111111'	;0A
			DT	B'10011111'	;0B
			DT	B'10011111'	;0C
			DT	B'11111111'	;0D
			DT	B'11111111'	;0E
			DT	B'11111111'	;0F


FONT2_B
			MOVLW	0
			MOVWF	PCLATU,0
			MOVLW	0X6B
			MOVWF	PCLATH,0

			MOVFF	BTCOUNT,WREG
			BCF		STATUS,C
			RLCF	WREG

		
			ADDWF	PCL,1,0
			DT	B'11111111',B'11111111'	;BTC=00
			DT	B'11111111',B'11111111'	;BTC=01
			DT	B'11100111',B'11111111'	;BTC=02
			DT	B'11000011',B'11111111'	;BTC=03
			DT	B'11000011',B'11111111'	;BTC=04
			DT	B'11100111',B'11111111'	;BTC=05
			DT	B'11111111',B'11111111'	;BTC=06
			DT	B'11111111',B'11111111'	;BTC=07
			DT	B'11111111',B'11111111'	;BTC=08
			DT	B'11111111',B'11111111'	;BTC=09
			DT	B'11111111',B'11111111'	;BTC=0A
			DT	B'11100111',B'11111111'	;BTC=0B
			DT	B'11000011',B'11111111'	;BTC=0C
			DT	B'11000011',B'11111111'	;BTC=0D
			DT	B'11100111',B'11111111'	;BTC=0E
			DT	B'11111111',B'11111111'	;BTC=0F




ORG	0X6C00
FONT1_C
			MOVLW	0
			MOVWF	PCLATU,0
			MOVLW	0X6C
			MOVWF	PCLATH,0

			MOVFF	BTCOUNT,WREG
			BCF		STATUS,C


			ADDWF	PCL,1,0
			DT	B'11111111'
			DT	B'11111111'
			DT	B'11111000'
			DT	B'11110001'
			DT	B'11100011'
			DT	B'11000111'
			DT	B'10001111'
			DT	B'00011111'
			DT	B'00011111'
			DT	B'10001111'
			DT	B'11000111'
			DT	B'11100011'
			DT	B'11110001'
			DT	B'11111000'
			DT	B'11111111'
			DT	B'11111111'

ORG	0X6D00
FONT1_D
			MOVLW	0
			MOVWF	PCLATU,0
			MOVLW	0X6D
			MOVWF	PCLATH,0

			MOVFF	BTCOUNT,WREG
			BCF		STATUS,C


			ADDWF	PCL,1,0
			DT	B'11111111'
			DT	B'11111111'
			DT	B'00011111'
			DT	B'10001111'
			DT	B'11000111'
			DT	B'11100011'
			DT	B'11110001'
			DT	B'11111000'
			DT	B'11111000'
			DT	B'11110001'
			DT	B'11100011'
			DT	B'11000111'
			DT	B'10001111'
			DT	B'00011111'
			DT	B'11111111'
			DT	B'11111111'



ORG	0X7000
FONT0_A
			MOVLW	0
			MOVWF	PCLATU,0
			MOVLW	0X70
			MOVWF	PCLATH,0

			MOVFF	BTCOUNT,WREG
			BCF		STATUS,C


			ADDWF	PCL,1,0
			DT	B'11111111'	;00
			DT	B'11111111'	;01
			DT	B'01111111'	;02
			DT	B'11111111'	;03
			DT	B'11111111'	;04
			DT	B'01111111'	;05
			DT	B'11111111'	;06
			DT	B'11111111'	;07

FONT0_B
			MOVLW	0
			MOVWF	PCLATU,0
			MOVLW	0X70
			MOVWF	PCLATH,0

			MOVFF	BTCOUNT,WREG
			BCF		STATUS,C


			ADDWF	PCL,1,0
			DT	B'11011111'	;00
			DT	B'10101111'	;01
			DT	B'01110111'	;02
			DT	B'00000111'	;03
			DT	B'01110111'	;04
			DT	B'01110111'	;05	
			DT	B'01110111'	;06
			DT	B'11111111'	;07

FONT0_C
			MOVLW	0
			MOVWF	PCLATU,0
			MOVLW	0X70
			MOVWF	PCLATH,0

			MOVFF	BTCOUNT,WREG
			BCF		STATUS,C


			ADDWF	PCL,1,0
			DT	B'11011111'	;00
			DT	B'10101111'	;01
			DT	B'01110111'	;02
			DT	B'00000111'	;03
			DT	B'01110111'	;04
			DT	B'01110111'	;05	
			DT	B'01110111'	;06
			DT	B'11111111'	;07

FONT0_D
			MOVLW	0
			MOVWF	PCLATU,0
			MOVLW	0X70
			MOVWF	PCLATH,0

			MOVFF	BTCOUNT,WREG
			BCF		STATUS,C


			ADDWF	PCL,1,0
			DT	B'11011111'	;00
			DT	B'10101111'	;01
			DT	B'01110111'	;02
			DT	B'00000111'	;03
			DT	B'01110111'	;04
			DT	B'01110111'	;05	
			DT	B'01110111'	;06
			DT	B'11111111'	;07


FONT0_E
			MOVLW	0
			MOVWF	PCLATU,0
			MOVLW	0X70
			MOVWF	PCLATH,0

			MOVFF	BTCOUNT,WREG
			BCF		STATUS,C


			ADDWF	PCL,1,0
			DT	B'11011111'	;00
			DT	B'10101111'	;01
			DT	B'01110111'	;02
			DT	B'00000111'	;03
			DT	B'01110111'	;04
			DT	B'01110111'	;05	
			DT	B'01110111'	;06
			DT	B'11111111'	;07


FONT0_F
			MOVLW	0
			MOVWF	PCLATU,0
			MOVLW	0X70
			MOVWF	PCLATH,0

			MOVFF	BTCOUNT,WREG
			BCF		STATUS,C

			ADDWF	PCL,1,0
			DT	B'11011111'	;00
			DT	B'10101111'	;01
			DT	B'01110111'	;02
			DT	B'00000111'	;03
			DT	B'01110111'	;04
			DT	B'01110111'	;05	
			DT	B'01110111'	;06
			DT	B'11111111'	;07


ORG	0X7100
FONT0_10
			MOVLW	0
			MOVWF	PCLATU,0
			MOVLW	0X71
			MOVWF	PCLATH,0

			MOVFF	BTCOUNT,WREG
			BCF		STATUS,C


			ADDWF	PCL,1,0
			DT	B'10001111'	;00
			DT	B'01110111'	;01
			DT	B'01110111'	;02
			DT	B'00000111'	;03
			DT	B'01110111'	;04
			DT	B'01110111'	;05
			DT	B'01110111'	;06
			DT	B'11111111'	;07

FONT0_11
			MOVLW	0
			MOVWF	PCLATU,0
			MOVLW	0X71
			MOVWF	PCLATH,0

			MOVFF	BTCOUNT,WREG
			BCF		STATUS,C


			ADDWF	PCL,1,0
			DT	B'00001111'	;00
			DT	B'01110111'	;01
			DT	B'01110111'	;02
			DT	B'00001111'	;03
			DT	B'01110111'	;04
			DT	B'01110111'	;05
			DT	B'00001111'	;06
			DT	B'11111111'	;07

FONT0_12
			MOVLW	0
			MOVWF	PCLATU,0
			MOVLW	0X71
			MOVWF	PCLATH,0

			MOVFF	BTCOUNT,WREG
			BCF		STATUS,C


			ADDWF	PCL,1,0
			DT	B'10001111'	;00
			DT	B'01110111'	;01
			DT	B'01111111'	;02
			DT	B'01111111'	;03
			DT	B'01111111'	;04
			DT	B'01110111'	;05
			DT	B'10001111'	;06
			DT	B'11111111'	;07

FONT0_13
			MOVLW	0
			MOVWF	PCLATU,0
			MOVLW	0X71
			MOVWF	PCLATH,0

			MOVFF	BTCOUNT,WREG
			BCF		STATUS,C


			ADDWF	PCL,1,0
			DT	B'00001111'	;00
			DT	B'01110111'	;01
			DT	B'01110111'	;02
			DT	B'01110111'	;03
			DT	B'01110111'	;04
			DT	B'01110111'	;05
			DT	B'00001111'	;06
			DT	B'11111111'	;07

FONT0_14
			MOVLW	0
			MOVWF	PCLATU,0
			MOVLW	0X71
			MOVWF	PCLATH,0

			MOVFF	BTCOUNT,WREG
			BCF		STATUS,C

			ADDWF	PCL,1,0
			DT	B'00000111'	;00
			DT	B'01111111'	;01
			DT	B'01111111'	;02
			DT	B'00001111'	;03
			DT	B'01111111'	;04
			DT	B'01111111'	;05
			DT	B'00000111'	;06
			DT	B'11111111'	;07

FONT0_15
			MOVLW	0
			MOVWF	PCLATU,0
			MOVLW	0X71
			MOVWF	PCLATH,0

			MOVFF	BTCOUNT,WREG
			BCF		STATUS,C

			ADDWF	PCL,1,0
			DT	B'00000111'	;00
			DT	B'01111111'	;01
			DT	B'01111111'	;02
			DT	B'00001111'	;03
			DT	B'01111111'	;04
			DT	B'01111111'	;05
			DT	B'01111111'	;06
			DT	B'11111111'	;07


FONT0_16
			MOVLW	0
			MOVWF	PCLATU,0
			MOVLW	0X71
			MOVWF	PCLATH,0

			MOVFF	BTCOUNT,WREG
			BCF		STATUS,C

			ADDWF	PCL,1,0
			DT	B'10001111'	;00
			DT	B'01110111'	;01
			DT	B'01111111'	;02
			DT	B'01000111'	;03
			DT	B'01110111'	;04
			DT	B'01110111'	;05
			DT	B'10001111'	;06
			DT	B'11111111'	;07


FONT0_17
			MOVLW	0
			MOVWF	PCLATU,0
			MOVLW	0X71
			MOVWF	PCLATH,0

			MOVFF	BTCOUNT,WREG
			BCF		STATUS,C

			ADDWF	PCL,1,0
			DT	B'01110111'	;00
			DT	B'01110111'	;01
			DT	B'01110111'	;02
			DT	B'00000111'	;03
			DT	B'01110111'	;04
			DT	B'01110111'	;05
			DT	B'01110111'	;06
			DT	B'11111111'	;07

ORG	0X7200
FONT0_18
			MOVLW	0
			MOVWF	PCLATU,0
			MOVLW	0X72
			MOVWF	PCLATH,0

			MOVFF	BTCOUNT,WREG
			BCF		STATUS,C

			ADDWF	PCL,1,0
			DT	B'00000111'	;00
			DT	B'11011111'	;01
			DT	B'11011111'	;02
			DT	B'11011111'	;03
			DT	B'11011111'	;04
			DT	B'11011111'	;05
			DT	B'00000111'	;06
			DT	B'11111111'	;07

FONT0_19
			MOVLW	0
			MOVWF	PCLATU,0
			MOVLW	0X72
			MOVWF	PCLATH,0

			MOVFF	BTCOUNT,WREG
			BCF		STATUS,C

			ADDWF	PCL,1,0
			DT	B'10000111'	;00
			DT	B'11110111'	;01
			DT	B'11110111'	;02
			DT	B'11110111'	;03
			DT	B'11110111'	;04
			DT	B'01110111'	;05
			DT	B'10001111'	;06
			DT	B'11111111'	;07


FONT0_1A
			MOVLW	0
			MOVWF	PCLATU,0
			MOVLW	0X72
			MOVWF	PCLATH,0

			MOVFF	BTCOUNT,WREG
			BCF		STATUS,C

			ADDWF	PCL,1,0
			DT	B'01110111'	;00
			DT	B'01110111'	;01
			DT	B'01101111'	;02
			DT	B'00011111'	;03
			DT	B'01101111'	;04
			DT	B'01110111'	;05
			DT	B'01110111'	;06
			DT	B'11111111'	;07

FONT0_1B
			MOVLW	0
			MOVWF	PCLATU,0
			MOVLW	0X72
			MOVWF	PCLATH,0

			MOVFF	BTCOUNT,WREG
			BCF		STATUS,C

			ADDWF	PCL,1,0
			DT	B'01111111'	;00
			DT	B'01111111'	;01
			DT	B'01111111'	;02
			DT	B'01111111'	;03
			DT	B'01111111'	;04
			DT	B'01111111'	;05
			DT	B'00000111'	;06
			DT	B'11111111'	;07


FONT0_1C
			MOVLW	0
			MOVWF	PCLATU,0
			MOVLW	0X72
			MOVWF	PCLATH,0

			MOVFF	BTCOUNT,WREG
			BCF		STATUS,C

			ADDWF	PCL,1,0
			DT	B'01110111'	;00
			DT	B'00100111'	;01
			DT	B'01010111'	;02
			DT	B'01110111'	;03
			DT	B'01110111'	;04
			DT	B'01110111'	;05
			DT	B'01110111'	;06
			DT	B'11111111'	;07

FONT0_1D
			MOVLW	0
			MOVWF	PCLATU,0
			MOVLW	0X72
			MOVWF	PCLATH,0

			MOVFF	BTCOUNT,WREG
			BCF		STATUS,C

			ADDWF	PCL,1,0
			DT	B'01110111'	;00
			DT	B'01110111'	;01
			DT	B'00110111'	;02
			DT	B'01010111'	;03
			DT	B'01100111'	;04
			DT	B'01110111'	;05
			DT	B'01110111'	;06
			DT	B'11111111'	;07


FONT0_1E
			MOVLW	0
			MOVWF	PCLATU,0
			MOVLW	0X72
			MOVWF	PCLATH,0

			MOVFF	BTCOUNT,WREG
			BCF		STATUS,C

			ADDWF	PCL,1,0
			DT	B'10001111'	;00
			DT	B'01110111'	;01
			DT	B'01110111'	;02
			DT	B'01110111'	;03
			DT	B'01110111'	;04
			DT	B'01110111'	;05
			DT	B'10001111'	;06
			DT	B'11111111'	;07


FONT0_1F
			MOVLW	0
			MOVWF	PCLATU,0
			MOVLW	0X72
			MOVWF	PCLATH,0

			MOVFF	BTCOUNT,WREG
			BCF		STATUS,C

			ADDWF	PCL,1,0
			DT	B'00001111'	;00
			DT	B'01110111'	;01
			DT	B'01110111'	;02
			DT	B'00001111'	;03
			DT	B'01111111'	;04
			DT	B'01111111'	;05
			DT	B'01111111'	;06
			DT	B'11111111'	;07


ORG	0X7300
FONT0_20
			MOVLW	0
			MOVWF	PCLATU,0
			MOVLW	0X73
			MOVWF	PCLATH,0

			MOVFF	BTCOUNT,WREG
			BCF		STATUS,C

			ADDWF	PCL,1,0
			DT	B'10001111'	;00
			DT	B'01110111'	;01
			DT	B'01110111'	;02
			DT	B'01110111'	;03
			DT	B'01110111'	;04
			DT	B'10001111'	;05
			DT	B'11110111'	;06
			DT	B'11111111'	;07


FONT0_21
			MOVLW	0
			MOVWF	PCLATU,0
			MOVLW	0X73
			MOVWF	PCLATH,0

			MOVFF	BTCOUNT,WREG
			BCF		STATUS,C

			ADDWF	PCL,1,0
			DT	B'00001111'	;00
			DT	B'01110111'	;01
			DT	B'01110111'	;02
			DT	B'00001111'	;03
			DT	B'01110111'	;04
			DT	B'01110111'	;05
			DT	B'01110111'	;06
			DT	B'11111111'	;07


FONT0_22
			MOVLW	0
			MOVWF	PCLATU,0
			MOVLW	0X73
			MOVWF	PCLATH,0

			MOVFF	BTCOUNT,WREG
			BCF		STATUS,C

			ADDWF	PCL,1,0
			DT	B'10001111'	;00
			DT	B'01110111'	;01
			DT	B'01111111'	;02
			DT	B'10001111'	;03
			DT	B'11110111'	;04
			DT	B'01110111'	;05
			DT	B'10001111'	;06
			DT	B'11111111'	;07


FONT0_23
			MOVLW	0
			MOVWF	PCLATU,0
			MOVLW	0X73
			MOVWF	PCLATH,0

			MOVFF	BTCOUNT,WREG
			BCF		STATUS,C

			ADDWF	PCL,1,0
			DT	B'00000111'	;00
			DT	B'11011111'	;01
			DT	B'11011111'	;02
			DT	B'11011111'	;03
			DT	B'11011111'	;04
			DT	B'11011111'	;05
			DT	B'11011111'	;06
			DT	B'11111111'	;07

FONT0_24
			MOVLW	0
			MOVWF	PCLATU,0
			MOVLW	0X73
			MOVWF	PCLATH,0

			MOVFF	BTCOUNT,WREG
			BCF		STATUS,C

			ADDWF	PCL,1,0
			DT	B'01110111'	;00
			DT	B'01110111'	;01
			DT	B'01110111'	;02
			DT	B'01110111'	;03
			DT	B'01110111'	;04
			DT	B'01110111'	;05
			DT	B'10001111'	;06
			DT	B'11111111'	;07



FONT0_25
			MOVLW	0
			MOVWF	PCLATU,0
			MOVLW	0X73
			MOVWF	PCLATH,0

			MOVFF	BTCOUNT,WREG
			BCF		STATUS,C

			ADDWF	PCL,1,0
			DT	B'01110111'	;00
			DT	B'01110111'	;01
			DT	B'01110111'	;02
			DT	B'01110111'	;03
			DT	B'01110111'	;04
			DT	B'10101111'	;05
			DT	B'11011111'	;06
			DT	B'11111111'	;07

FONT0_26
			MOVLW	0
			MOVWF	PCLATU,0
			MOVLW	0X73
			MOVWF	PCLATH,0

			MOVFF	BTCOUNT,WREG
			BCF		STATUS,C

			ADDWF	PCL,1,0
			DT	B'01110111'	;00
			DT	B'01110111'	;01
			DT	B'01110111'	;02
			DT	B'01110111'	;03
			DT	B'01010111'	;04
			DT	B'00100111'	;05
			DT	B'01110111'	;06
			DT	B'11111111'	;07


FONT0_27
			MOVLW	0
			MOVWF	PCLATU,0
			MOVLW	0X73
			MOVWF	PCLATH,0

			MOVFF	BTCOUNT,WREG
			BCF		STATUS,C

			ADDWF	PCL,1,0
			DT	B'01110111'	;00
			DT	B'01110111'	;01
			DT	B'10101111'	;02
			DT	B'11011111'	;03
			DT	B'10101111'	;04
			DT	B'01110111'	;05
			DT	B'01110111'	;06
			DT	B'11111111'	;07




ORG	0X7400
FONT0_28
			MOVLW	0
			MOVWF	PCLATU,0
			MOVLW	0X74
			MOVWF	PCLATH,0

			MOVFF	BTCOUNT,WREG
			BCF		STATUS,C

			ADDWF	PCL,1,0
			DT	B'01110111'	;00
			DT	B'01110111'	;01
			DT	B'10101111'	;02
			DT	B'11011111'	;03
			DT	B'11011111'	;04
			DT	B'11011111'	;05
			DT	B'11011111'	;06
			DT	B'11111111'	;07

FONT0_29
			MOVLW	0
			MOVWF	PCLATU,0
			MOVLW	0X74
			MOVWF	PCLATH,0

			MOVFF	BTCOUNT,WREG
			BCF		STATUS,C

			ADDWF	PCL,1,0
			DT	B'00000111'	;00
			DT	B'11110111'	;01
			DT	B'11101111'	;02
			DT	B'11011111'	;03
			DT	B'10111111'	;04
			DT	B'01111111'	;05
			DT	B'00000111'	;06
			DT	B'11111111'	;07