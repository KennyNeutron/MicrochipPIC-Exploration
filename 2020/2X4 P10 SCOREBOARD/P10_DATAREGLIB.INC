ORG 0XF000
;==========	DELAY USEC =========
DELAY_US

	MOVWF	DELAYUS

USEC

	NOP
 	NOP
	NOP
	NOP
DECFSZ	DELAYUS,F

GOTO	USEC

RETURN
;=================================



;=========== DELAY ONE MS ========
DELAY_ONEMS

	MOVLW	.5
	MOVWF	LOOP

MSEC
	MOVLW	.200
	CALL	DELAY_US
	DECFSZ	LOOP,F
	GOTO	MSEC

RETURN
;==================================


;=========== DELAY MS	==========
DELAY_MS
	
	MOVWF	DELAYMS
MSEC0
	CALL	DELAY_ONEMS
	DECFSZ	DELAYMS,F
	GOTO	MSEC0
RETURN
;=================================

;=========== DELAY	ONE	SECOND ===
DELAY_ONESEC

	MOVLW	.5
	MOVWF	SEC
SEC0
	MOVLW	.200
	CALL	DELAY_MS
	DECFSZ	SEC,F
	GOTO	SEC0
RETURN
;=================================

;==========	DELAY SEC ============
DELAY_SEC

	MOVWF	DELAYS
SEC1
	CALL	DELAY_ONESEC
	DECFSZ	DELAYS,F
	GOTO	SEC1
RETURN
;=================================


;=====================	CLEAR	DRAM0		===================
CLR_DRAM0
	MOVLB		0X01	;BANK2
	MOVLW		0XFF
	MOVWF		POINTER

	MOVLW		0X02
	MOVWF		FSR0H,0

	MOVLW		0X00
	MOVWF		FSR0L,0  

	MOVLW		0XFF

CLR_DRAM0A
	MOVWF		INDF0

	INCF		FSR0L
	DECFSZ		POINTER, F
	GOTO		CLR_DRAM0A
	MOVWF		INDF0
	
RETURN
;==============================================================


;=====================	CLEAR	DRAM1		===================
CLR_DRAM1
	MOVLB		0X01	;BANK2
	MOVLW		0XFF
	MOVWF		POINTER

	MOVLW		0X03
	MOVWF		FSR0H,0

	MOVLW		0X00
	MOVWF		FSR0L,0  

	MOVLW		0XFF

CLR_DRAM1A
	MOVWF		INDF0

	INCF		FSR0L
	DECFSZ		POINTER, F
	GOTO		CLR_DRAM1A
	MOVWF		INDF0
	
RETURN
;==============================================================

;=======================	CLEAR	TEMP	RAM		===========
CLR_TEMPRAM
	MOVLB		0X01	;BANK2
	MOVLW		0X3F
	MOVWF		POINTER

	MOVLW		0X01
	MOVWF		FSR0H,0

	MOVLW		0X20
	MOVWF		FSR0L,0  

	MOVLW		0XFF

CLR_TRAM0
	MOVWF		INDF0

	INCF		FSR0L
	DECFSZ		POINTER, F
	GOTO		CLR_TRAM0
	MOVWF		INDF0
	
	RETURN
;==============================================================


;@@@@@@@@@@@@@@@@@@@@@@@@@@@@	REGISTER DATA	@@@@@@@@@@@@@@@@@@@@@
DATAREG0:
	MOVLW	0X02
	MOVWF	FSR0H,0


	MOVFF	REG_STPT,FSR0L
	
	CALL	DATAREG_J1	;P10 MODULE 03

	MOVLW	0X04
	ADDWF	REG_STPT

	MOVFF	REG_STPT,FSR0L
	
	CALL	DATAREG_J1	;P10 MODULE 02


	MOVLW	0X84
	SUBWF	REG_STPT

	MOVFF	REG_STPT,FSR0L
	
	CALL	DATAREG_J0		;P10 MODULE 01

	MOVLW	0X04
	ADDWF	REG_STPT

	MOVFF	REG_STPT,FSR0L
	
	CALL	DATAREG_J0	;P10 MODULE 00

RETURN


DATAREG1:
	MOVLW	0X03
	MOVWF	FSR0H,0


	MOVFF	REG_STPT,FSR0L
	
	CALL	DATAREG_J3	;P10 MODULE 07

	MOVLW	0X04
	ADDWF	REG_STPT

	MOVFF	REG_STPT,FSR0L
	
	CALL	DATAREG_J3	;P10 MODULE 06

	MOVLW	0X84
	SUBWF	REG_STPT

	MOVFF	REG_STPT,FSR0L
	
	CALL	DATAREG_J2		;P10 MODULE 01

	MOVLW	0X04
	ADDWF	REG_STPT

	MOVFF	REG_STPT,FSR0L
	
	CALL	DATAREG_J2	;P10 MODULE 00



RETURN

;****************************************************
DATAREG_J0 ;MODULE0-MODULE1
;****************************************************

	MOVLW	0X04
	MOVWF	COUNT0

DTRJ0_ST1

	MOVLW	0X04
	MOVWF	DREGCOUNT

DTRJ00
	MOVLW	0X08
	MOVWF	BYTECOUNT

	MOVFF	INDF0,DATAHOLD
DTRJ01
	RLCF	DATAHOLD
	
	BTFSS	STATUS,C
	GOTO	DTRJ01_BIT0
	GOTO	DTRJ01_BIT1

DTRJ01_BIT0
	DAT0_0
	GOTO	DTRJ02

DTRJ01_BIT1
	DAT0_1
	GOTO	DTRJ02
NOP
DTRJ02
	CLK0_ON
	CLK0_OFF
	DECFSZ	BYTECOUNT,F
	GOTO	DTRJ01

	MOVLW	0X20
	ADDWF	FSR0L
	
	DECFSZ	DREGCOUNT,F
	GOTO	DTRJ00

	MOVLW	0X80
	ADDWF	FSR0L
	INCF	FSR0L

	DECFSZ	COUNT0,F
	GOTO	DTRJ0_ST1

RETURN
;****************************************************




;****************************************************
DATAREG_J1 ;MODULE2-MODULE3
;****************************************************

	MOVLW	0X04
	MOVWF	COUNT0

DTRJ1_ST1

	MOVLW	0X04
	MOVWF	DREGCOUNT

DTRJ10
	MOVLW	0X08
	MOVWF	BYTECOUNT

	MOVFF	INDF0,DATAHOLD
DTRJ11
	RLCF	DATAHOLD
	
	BTFSS	STATUS,C
	GOTO	DTRJ11_BIT0
	GOTO	DTRJ11_BIT1

DTRJ11_BIT0
	DAT1_0
	GOTO	DTRJ12

DTRJ11_BIT1
	DAT1_1
	GOTO	DTRJ12
NOP
DTRJ12
	CLK1_ON
	CLK1_OFF
	DECFSZ	BYTECOUNT,F
	GOTO	DTRJ11

	MOVLW	0X20
	ADDWF	FSR0L
	
	DECFSZ	DREGCOUNT,F
	GOTO	DTRJ10

	MOVLW	0X80
	ADDWF	FSR0L
	INCF	FSR0L

	DECFSZ	COUNT0,F
	GOTO	DTRJ1_ST1

RETURN
;****************************************************

;****************************************************
DATAREG_J2 ;MODULE4-MODULE5
;****************************************************

	MOVLW	0X04
	MOVWF	COUNT0

DTRJ2_ST1

	MOVLW	0X04
	MOVWF	DREGCOUNT

DTRJ20
	MOVLW	0X08
	MOVWF	BYTECOUNT

	MOVFF	INDF0,DATAHOLD
DTRJ21
	RLCF	DATAHOLD
	
	BTFSS	STATUS,C
	GOTO	DTRJ21_BIT0
	GOTO	DTRJ21_BIT1

DTRJ21_BIT0
	DAT2_0
	GOTO	DTRJ22

DTRJ21_BIT1
	DAT2_1
	GOTO	DTRJ22
NOP
DTRJ22
	CLK2_ON
	CLK2_OFF
	DECFSZ	BYTECOUNT,F
	GOTO	DTRJ21

	MOVLW	0X20
	ADDWF	FSR0L
	
	DECFSZ	DREGCOUNT,F
	GOTO	DTRJ20

	MOVLW	0X80
	ADDWF	FSR0L
	INCF	FSR0L

	DECFSZ	COUNT0,F
	GOTO	DTRJ2_ST1

RETURN
;****************************************************


;****************************************************
DATAREG_J3 ;MODULE6-MODULE7
;****************************************************

	MOVLW	0X04
	MOVWF	COUNT0

DTRJ3_ST1

	MOVLW	0X04
	MOVWF	DREGCOUNT

DTRJ30
	MOVLW	0X08
	MOVWF	BYTECOUNT

	MOVFF	INDF0,DATAHOLD
DTRJ31
	RLCF	DATAHOLD
	
	BTFSS	STATUS,C
	GOTO	DTRJ31_BIT0
	GOTO	DTRJ31_BIT1

DTRJ31_BIT0
	DAT3_0
	GOTO	DTRJ32

DTRJ31_BIT1
	DAT3_1
	GOTO	DTRJ32
NOP
DTRJ32
	CLK3_ON
	CLK3_OFF
	DECFSZ	BYTECOUNT,F
	GOTO	DTRJ31

	MOVLW	0X20
	ADDWF	FSR0L
	
	DECFSZ	DREGCOUNT,F
	GOTO	DTRJ30

	MOVLW	0X80
	ADDWF	FSR0L
	INCF	FSR0L

	DECFSZ	COUNT0,F
	GOTO	DTRJ3_ST1

RETURN
;****************************************************


;@@@@@@@@@@@@@@@@@@@@@@@@@@@@@@@@@@@@@@@@@@@@@@@@@@@@@@@@@@@@@@@@@@@@



