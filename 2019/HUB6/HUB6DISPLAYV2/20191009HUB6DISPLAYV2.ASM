;**********************************************************************
;                                                                     *
;    FILENAME:	    HUBDISPLAYV2.ASM                                  *
;    DATE:          20191010                                          *
;    FILE VERSION:                                                    *
;                                                                     *
;    AUTHOR:       KENNY NEUTRON                                      *
;    COMPANY:      GER-PER ENGINEERING                                *
;                                                                     * 
;                                                                     *
;**********************************************************************
;                                                                     *
;    FILES REQUIRED: P16F690.INC                                      *
;                                                                     *
;**********************************************************************


	LIST		P=16F690		; LIST DIRECTIVE TO DEFINE PROCESSOR
	#INCLUDE	<P16F690.INC>		; PROCESSOR SPECIFIC VARIABLE DEFINITIONS
	
	__CONFIG    _CP_OFF & _CPD_OFF & _BOR_OFF & _PWRTE_ON & _WDT_OFF & _HS_OSC & _MCLRE_OFF & _FCMEN_OFF & _IESO_OFF

; '__CONFIG' DIRECTIVE IS USED TO EMBED CONFIGURATION DATA WITHIN .ASM FILE.
; THE LABELS FOLLOWING THE DIRECTIVE ARE LOCATED IN THE RESPECTIVE .INC FILE.
; SEE RESPECTIVE DATA SHEET FOR ADDITIONAL INFORMATION ON CONFIGURATION WORD.






;***** VARIABLE DEFINITIONS
W_TEMP		EQU	0X7D			; VARIABLE USED FOR CONTEXT SAVING
STATUS_TEMP	EQU	0X7E			; VARIABLE USED FOR CONTEXT SAVING
PCLATH_TEMP	EQU	0X7F			; VARIABLE USED FOR CONTEXT SAVING


	;#DEFINE C0_ON		BSF PORTC,	0	PORTC0=====>HI
	;#DEFINE C0_OFF		BCF PORTC,	0	PORTC0=====>LO

	#DEFINE	OE_ON		BCF	PORTA, 2
	#DEFINE	OE_OFF		BSF	PORTA, 2

	#DEFINE	A_ON		BSF	PORTC, 0
	#DEFINE A_OFF		BCF	PORTC, 0
	
	#DEFINE B_ON		BSF	PORTC, 1
	#DEFINE B_OFF		BCF PORTC, 1

	#DEFINE C_ON		BSF	PORTC, 2
	#DEFINE C_OFF		BCF	PORTC, 2
	
	#DEFINE D_ON		BSF	PORTC, 3
	#DEFINE D_OFF		BCF	PORTC, 3

	#DEFINE LAT_ON		BSF	PORTB, 4
	#DEFINE LAT_OFF		BCF	PORTB, 4

	#DEFINE CLK_ON      BSF	PORTB, 6
	#DEFINE CLK_OFF		BCF	PORTB, 6

;	#DEFINE	CYC_ON		BSF	PORTB,7
;	#DEFINE	CYC_OFF		BCF	PORTB,7


	#DEFINE R0_1		BSF	PORTC, 4
	#DEFINE R0_0		BCF	PORTC, 4
	
	#DEFINE R1_1		BSF	PORTC, 5
	#DEFINE R1_0		BCF	PORTC, 5

	#DEFINE	G0_1		BSF	PORTC, 6
	#DEFINE G0_0		BCF	PORTC, 6
	
	#DEFINE	G1_1		BSF	PORTC, 7
	#DEFINE	G1_0		BCF	PORTC, 7

	#DEFINE	WP_ON		BSF	PORTA,1
	#DEFINE	WP_OFF		BCF	PORTA,1

	#DEFINE	SDA_1		BSF	PORTB,7
	#DEFINE SDA_0		BCF	PORTB,7

	#DEFINE	SCL_1		BSF	PORTB,5
	#DEFINE	SCL_0		BCF	PORTB,5

	#DEFINE	BANK0		BANKSEL	PORTA
	#DEFINE	BANK1		BANKSEL	ADRESL
	#DEFINE	BANK2		BANKSEL	ANSELH

;============================	BANK	0	===========================
CBLOCK 0X20
			DRAM: .32
			DELAYUS, DELAYMS,  MILSEC, ;SEC,DELAYS,	;DELAY VARIABLES
			;=======================================================
			LOOP,COUNT0,COUNT1,COUNT2
			POINTER,BTCOUNT
			COLOR,NUMBER,ROW,FONT,STPT
			CURSORX,CURSORY,CURSORY_TEMP
			REDHALF0,REDHALF1			;RED UPPER HALF : RED LOWER HALF RAMS
			GRNHALF0,GRNHALF1			;GRN UPPER HALF	: GRN LOWER HAL
			TEMPRAM:.8

			TESTNUM
			TESTLOOP
			PERIOD
			I2CREG,I2CLOOP
ENDC
;======================================================================


;============================	BANK	1	===========================
CBLOCK 0XA0

ENDC
;======================================================================



;============================	BANK	2	===========================
CBLOCK 0X120


ENDC
;======================================================================

;**************************************************	********************
	ORG		0X000				; PROCESSOR RESET VECTOR
	GOTO	INIT				; GO TO BEGINNING OF PROGRAM


	ORG		0X004				; INTERRUPT VECTOR LOCATION
	MOVWF		W_TEMP			; SAVE OFF CURRENT W REGISTER CONTENTS
	MOVF		STATUS,W		; MOVE STATUS REGISTER INTO W REGISTER
	MOVWF		STATUS_TEMP		; SAVE OFF CONTENTS OF STATUS REGISTER
	MOVF		PCLATH,W		; MOVE PCLATH REGISTER INTO W REGISTER
	MOVWF		PCLATH_TEMP		; SAVE OFF CONTENTS OF PCLATH REGISTER

; ISR CODE CAN GO HERE OR BE LOCATED AS A CALL SUBROUTINE ELSEWHERE

	MOVF		PCLATH_TEMP,W	; RETRIEVE COPY OF PCLATH REGISTER
	MOVWF		PCLATH			; RESTORE PRE-ISR PCLATH REGISTER CONTENTS	
	MOVF		STATUS_TEMP,W	; RETRIEVE COPY OF STATUS REGISTER
	MOVWF		STATUS			; RESTORE PRE-ISR STATUS REGISTER CONTENTS
	SWAPF		W_TEMP,F
	SWAPF		W_TEMP,W		; RESTORE PRE-ISR W REGISTER CONTENTS
	RETFIE						; RETURN FROM INTERRUPT


;$$$$$$$$$$$$$$$$$$$$$	INITIALIZE	$$$$$$$$$$$$$$$$$$$$$$$$$$$$$$$$
INIT
BANKSEL	ANSEL
CLRW
MOVWF	ANSEL
MOVWF	ANSELH

BANKSEL	TRISA

MOVLW	0
MOVWF	TRISA

MOVLW	0
MOVWF	TRISB

MOVLW	0
MOVWF	TRISC



BANK0
A_OFF
B_OFF
C_OFF
D_OFF
CLK_OFF
LAT_OFF
R1_0
R2_0
G1_0
G2_0
OE_ON

CALL	CLR_RAM

MOVLW	0XAA
MOVWF	DRAM+08

MOVLW	0X55
MOVWF	DRAM+09




CALL	CLR_RAM
MOVLW	0
MOVWF	PCLATH
;#######################	MAIN PROGRAM  ##########################
MAIN
		BSF		PORTA,0
		CALL	DISPLAY
		BCF		PORTA,0
		CALL	DISPLAY
	

GOTO	MAIN
;###################################################################



DISPLAY

		MOVLW	.16
		MOVWF	COUNT2
		MOVLW	0
		MOVWF	ROW

DISP0	
		LAT_ON
		LAT_OFF
		OE_ON
		CALL	CLR_RAM


		CALL	COMMAND

		CALL	DATAREG
		OE_OFF
		MOVFW	ROW
		MOVWF	PORTC
		INCF	ROW
		DECFSZ	COUNT2,F

		GOTO	DISP0


RETURN

COMMAND
		MOVLW	2
		MOVWF	FONT

		MOVLW	1
		MOVWF	NUMBER
		MOVLW	2
		MOVWF	CURSORX
		MOVLW	0
		MOVWF	CURSORY
		MOVLW	0
		MOVWF	COLOR
		CALL	DUMP

		MOVLW	9
		MOVWF	NUMBER
		MOVLW	.11
		MOVWF	CURSORX
		MOVLW	0
		MOVWF	CURSORY
		MOVLW	1
		MOVWF	COLOR
		CALL	DUMP

		MOVLW	2
		MOVWF	NUMBER
		MOVLW	.43
		MOVWF	CURSORX
		MOVLW	0
		MOVWF	CURSORY
		MOVLW	2
		MOVWF	COLOR
		CALL	DUMP


		MOVLW	8
		MOVWF	NUMBER
		MOVLW	.54
		MOVWF	CURSORX
		MOVLW	0
		MOVWF	CURSORY
		MOVLW	2
		MOVWF	COLOR
		CALL	DUMP


;
;		MOVLW	5
;		MOVWF	NUMBER
;		MOVLW	.44
;		MOVWF	CURSORX
;		MOVLW	0
;		MOVWF	CURSORY
;		MOVLW	1
;		MOVWF	COLOR
;		CALL	DUMP
;
;		MOVLW	1
;		MOVWF	NUMBER
;		MOVLW	.55
;		MOVWF	CURSORX
;		MOVLW	0
;		MOVWF	CURSORY
;		MOVLW	0
;		MOVWF	COLOR
;		CALL	DUMP


		MOVLW	2
		MOVWF	NUMBER
		MOVLW	0
		MOVWF	CURSORX
		MOVLW	.16
		MOVWF	CURSORY
		MOVLW	1
		MOVWF	COLOR
		CALL	DUMP

		MOVLW	0
		MOVWF	NUMBER
		MOVLW	.11
		MOVWF	CURSORX
		MOVLW	.16
		MOVWF	CURSORY
		MOVLW	0
		MOVWF	COLOR
		CALL	DUMP


;
;		MOVLW	9
;		MOVWF	NUMBER
;		MOVLW	.54
;		MOVWF	CURSORX
;		MOVLW	.16
;		MOVWF	CURSORY
;		MOVLW	2
;		MOVWF	COLOR
;		CALL	DUMP
;
;




RETURN


;==========	DELAY USEC =========
DELAY_US

	MOVWF	DELAYUS

USEC

	NOP
 	NOP
	NOP
	NOP
DECFSZ	DELAYUS,F

GOTO	USEC

RETURN
;=================================



;=========== DELAY ONE MS ========
DELAY_ONEMS

	MOVLW	.5
	MOVWF	LOOP

MSEC
	MOVLW	.200
	CALL	DELAY_US
	DECFSZ	LOOP,F
	GOTO	MSEC

RETURN
;==================================


;=========== DELAY MS	==========
DELAY_MS
	
	MOVWF	DELAYMS
MSEC0
	CALL	DELAY_ONEMS
	DECFSZ	DELAYMS,F
	GOTO	MSEC0
RETURN
;=================================

;=========== DELAY	ONE	SECOND ===
;DELAY_ONESEC
;
;	MOVLW	.5
;	MOVWF	SEC
;SEC0
;	MOVLW	.200
;	CALL	DELAY_MS
;	DECFSZ	SEC,F
;	GOTO	SEC0
;RETURN
;;=================================
;
;;==========	DELAY SEC =========
;DELAY_SEC
;
;	MOVWF	DELAYS
;SEC1
;	CALL	DELAY_ONESEC
;	DECFSZ	DELAYS,F
;	GOTO	SEC1
;RETURN
;;=================================

;=======================	CLEAR	RAM		===============
CLR_RAM
	BANK0
	MOVLW		.32
	MOVWF		POINTER
	MOVLW		DRAM
	MOVWF		FSR  

CLR0
	MOVLW		0XFF
	MOVWF		INDF

	INCF		FSR, F
	DECFSZ		POINTER, F
	GOTO		CLR0
	 
	RETURN
;==========================================================



;=======================	REGISTER DATA		===============
DATAREG



	MOVLW	0X20
	MOVWF	FSR

	MOVLW	8
	MOVWF	COUNT0
	

DR0
	MOVFW	INDF
	MOVWF	REDHALF0
	

	BSF		FSR,3
	
	MOVFW	INDF
	MOVWF	REDHALF1


	BSF		FSR,4
	
	MOVFW	INDF
	MOVWF	GRNHALF1

	
	BCF		FSR,3

	MOVFW	INDF
	MOVWF	GRNHALF0

	MOVLW	8
	MOVWF	COUNT1

DR1
	RLF		REDHALF0
	
	BTFSS	STATUS,C
	GOTO	R0LO
	GOTO	R0HI

R0LO
	R0_1
	GOTO	DR2
R0HI
	R0_0
;-------------------
DR2
	RLF		REDHALF1
	
	BTFSS	STATUS,C
	GOTO	R1LO
	GOTO	R1HI

R1LO
	R1_1
	GOTO	DR3

R1HI
	R1_0
;-------------------
DR3
	
	RLF		GRNHALF0
	
	BTFSS	STATUS,C
	GOTO	G0LO
	GOTO	G0HI


G0LO
	G0_1
	GOTO	DR4

G0HI
	G0_0
;-------------------
DR4

	RLF		GRNHALF1

	BTFSS	STATUS,C
	GOTO	G1LO
	GOTO	G1HI


G1LO
	G1_1
	GOTO	DR5
G1HI
	G1_0
;-------------------
DR5
	

	CLK_ON
	CLK_OFF

	DECFSZ	COUNT1,F
	GOTO	DR1

	BCF		FSR,4
	INCF	FSR
	
	DECFSZ	COUNT0,F
	GOTO	DR0


RETURN
;==========================================================	









;=======================	DUMP DATA		===============
DUMP
		MOVFW	ROW
		MOVWF	BTCOUNT

		MOVFW	PCLATH
		MOVWF	PCLATH_TEMP
		MOVLW	0
		MOVWF	POINTER

		MOVLW	0XFF
		MOVWF	TEMPRAM+00
		MOVWF	TEMPRAM+01
		
		MOVFW	CURSORY
		MOVWF	CURSORY_TEMP

		MOVLW	.15
		MOVWF	W_TEMP

		MOVFW	CURSORY
		SUBWF	W_TEMP

		BTFSS	STATUS,C
		GOTO	UPPERH
		GOTO	DUMP0

UPPERH
		MOVLW	.16
		SUBWF	CURSORY


DUMP0

	;	INCF	PCLATH
		MOVFW	FONT
		ADDWF	PCL
		GOTO	DMP_FONT00
		GOTO	DMP_FONT01
		GOTO	DMP_FONT02


DMP_FONT00
		;CALL	FONT00
		MOVWF	TEMPRAM+00
		GOTO	DMP0

DMP_FONT01
		;CALL	FONT01
		MOVWF	TEMPRAM+00
		GOTO	DMP0

DMP_FONT02
		MOVLW	8
		MOVWF	PCLATH

		MOVFW	BTCOUNT
		ADDWF	BTCOUNT

		CALL	FONT02
		MOVWF	TEMPRAM+00
		INCF	BTCOUNT

		CALL	FONT02
		MOVWF	TEMPRAM+01

		MOVFW	PCLATH_TEMP
		MOVWF	PCLATH
		GOTO	DMP0


DMP0
		

		MOVFW	PCLATH_TEMP
		MOVWF	PCLATH
		CALL	DATAINRAM

RETURN
;==========================================================	


;=======================	PUT DATA IN RAM		===============
DATAINRAM

		MOVFW	CURSORX
		BTFSC	STATUS,Z
		GOTO	DIR1   ;DIR2(0)
		CALL	CURSORX_TEST
		MOVFW	LOOP
		BTFSC	STATUS,Z
		GOTO	DIR1
DIR0
		SETC
		RRF		TEMPRAM+00
		RRF		TEMPRAM+01

		DECFSZ	LOOP,F
		GOTO	DIR0

DIR1
		NOP
		MOVLW	.15
		MOVWF	W_TEMP

		MOVFW	CURSORY_TEMP
		SUBWF	W_TEMP

		BTFSS	STATUS,C
		GOTO	DIR2
		GOTO	DIR3

DIR2
		MOVFW	PCLATH
		MOVWF	PCLATH_TEMP

		MOVLW	0X20
		MOVWF	FSR

		MOVFW	POINTER
		ADDWF	FSR
		
		BTFSC	COLOR,1
		GOTO	DIR2_YELLOW		

		BTFSC	COLOR,0
		BSF		FSR,4

		

		MOVFW	TEMPRAM+00
		ANDWF	INDF

		INCF	FSR

		MOVFW	TEMPRAM+01
		ANDWF	INDF
RETURN

DIR2_YELLOW
		MOVFW	TEMPRAM+00
		ANDWF	INDF

		INCF	FSR

		MOVFW	TEMPRAM+01
		ANDWF	INDF

		DECF	FSR
		BSF		FSR,4

		MOVFW	TEMPRAM+00
		ANDWF	INDF

		INCF	FSR

		MOVFW	TEMPRAM+01
		ANDWF	INDF
		

RETURN

;DIR2(0)
;		MOVFW	TEMPRAM+00
;		ANDWF	DRAM+00
;RETURN


DIR3
		MOVFW	PCLATH
		MOVWF	PCLATH_TEMP

		MOVLW	0X28
		MOVWF	FSR
		
		MOVFW	POINTER
		ADDWF	FSR

		BTFSC	COLOR,1
		GOTO	DIR3_YELLOW	

		BTFSC	COLOR,0
		BSF		FSR,4
		
		MOVFW	TEMPRAM+00
		ANDWF	INDF
		
		INCF	FSR
		
		MOVFW	TEMPRAM+01
		ANDWF	INDF
RETURN


DIR3_YELLOW
		MOVFW	TEMPRAM+00
		ANDWF	INDF

		INCF	FSR

		MOVFW	TEMPRAM+01
		ANDWF	INDF

		DECF	FSR
		BSF		FSR,4

		MOVFW	TEMPRAM+00
		ANDWF	INDF

		INCF	FSR

		MOVFW	TEMPRAM+01
		ANDWF	INDF
		
;==========================================================	





CURSORX_TEST
		MOVWF	W_TEMP

		MOVLW	.8
		MOVWF	MILSEC ;TEMPVAR

		MOVFW	W_TEMP
		SUBWF	MILSEC

		BTFSS	STATUS,C
		GOTO	CXT08
		
		BTFSC	STATUS,Z
		GOTO	CXT08S	;CURSOR IS 16

		MOVFW	CURSORX
		MOVWF	LOOP
		
RETURN


CXT08
		MOVFW	CURSORX
		MOVWF	W_TEMP
		
		MOVLW	.16
		MOVWF	MILSEC	;TEMPVAR
		
		MOVFW	W_TEMP
		SUBWF	MILSEC
		
		BTFSS	STATUS,C
		GOTO	CXT16

		BTFSC	STATUS,Z
		GOTO	CXT16S	;CURSOR IS 24
		
		MOVFW	CURSORX
		MOVWF	LOOP
		MOVLW	.8
		SUBWF	LOOP
CXT08S
		MOVLW	1
		MOVWF	POINTER

RETURN

		
CXT16
		MOVFW	CURSORX
		MOVWF	W_TEMP
		
		MOVLW	.24
		MOVWF	MILSEC	;TEMPVAR
		
		MOVFW	W_TEMP
		SUBWF	MILSEC
		
		BTFSS	STATUS,C
		GOTO	CXT24

		BTFSC	STATUS,Z
		GOTO	CXT24S	;CURSOR IS 24
		
		MOVFW	CURSORX
		MOVWF	LOOP
		MOVLW	.16
		SUBWF	LOOP
CXT16S
		MOVLW	2
		MOVWF	POINTER

RETURN


CXT24
		MOVFW	CURSORX
		MOVWF	W_TEMP
		
		MOVLW	.32
		MOVWF	MILSEC	;TEMPVAR
		
		MOVFW	W_TEMP
		SUBWF	MILSEC
		
		BTFSS	STATUS,C
		GOTO	CXT32

		BTFSC	STATUS,Z
		GOTO	CXT32S	;CURSOR IS 32
		
		MOVFW	CURSORX
		MOVWF	LOOP
		MOVLW	.24
		SUBWF	LOOP
CXT24S
		MOVLW	3
		MOVWF	POINTER

RETURN

CXT32
		MOVFW	CURSORX
		MOVWF	W_TEMP
		
		MOVLW	.40
		MOVWF	MILSEC	;TEMPVAR
		
		MOVFW	W_TEMP
		SUBWF	MILSEC
		
		BTFSS	STATUS,C
		GOTO	CXT40

		BTFSC	STATUS,Z
		GOTO	CXT40S	;CURSOR IS 40
		
		MOVFW	CURSORX
		MOVWF	LOOP
		MOVLW	.32
		SUBWF	LOOP
CXT32S
		MOVLW	4
		MOVWF	POINTER

RETURN


CXT40
		MOVFW	CURSORX
		MOVWF	W_TEMP
		
		MOVLW	.48
		MOVWF	MILSEC	;TEMPVAR
		
		MOVFW	W_TEMP
		SUBWF	MILSEC
		
		BTFSS	STATUS,C
		GOTO	CXT48
	
		BTFSC	STATUS,Z
		GOTO	CXT48S	;CURSOR IS 48

		MOVFW	CURSORX
		MOVWF	LOOP
		MOVLW	.40
		SUBWF	LOOP
CXT40S
		MOVLW	5
		MOVWF	POINTER



RETURN

CXT48
		MOVFW	CURSORX
		MOVWF	W_TEMP
		
		MOVLW	.56
		MOVWF	MILSEC	;TEMPVAR
		
		MOVFW	W_TEMP
		SUBWF	MILSEC
		
		BTFSS	STATUS,C
		GOTO	CXT56

		BTFSC	STATUS,Z
		GOTO	CXT56S	;CURSOR IS 56
		
		MOVFW	CURSORX
		MOVWF	LOOP
		MOVLW	.48
		SUBWF	LOOP
CXT48S
		MOVLW	6
		MOVWF	POINTER

RETURN


CXT56
		MOVFW	CURSORX
		MOVWF	W_TEMP
		
		MOVLW	.64
		MOVWF	MILSEC	;TEMPVAR
		
		MOVFW	W_TEMP
		SUBWF	MILSEC
		
		BTFSS	STATUS,C
		GOTO	CXT64

		BTFSC	STATUS,Z
		GOTO	CXT64S	;CURSOR IS 64
		
		MOVFW	CURSORX
		MOVWF	LOOP
		MOVLW	.56
		SUBWF	LOOP
CXT56S
		MOVLW	7
		MOVWF	POINTER

RETURN

CXT64

		MOVFW	CURSORX
		MOVWF	W_TEMP
		
		MOVLW	.72
		MOVWF	MILSEC	;TEMPVAR
		
		MOVFW	W_TEMP
		SUBWF	MILSEC
		
		BTFSS	STATUS,C
		;GOTO	CXT64
		RETURN

		BTFSC	STATUS,Z
		;GOTO	CXT64S	;CURSOR IS 56
		RETURN
		
		MOVFW	CURSORX
		MOVWF	LOOP
		MOVLW	.56
		SUBWF	LOOP
CXT64S
		MOVLW	7
		MOVWF	POINTER

RETURN













ORG 0X800
FONT02

	MOVLW	8
	MOVWF	PCLATH	
	MOVFW	NUMBER
	ADDWF	PCL,F
	
	GOTO	FONT02_ZERO
	
	GOTO	FONT02_ONE

	GOTO	FONT02_TWO

	GOTO	FONT02_THREE

	GOTO	FONT02_FOUR

	GOTO	FONT02_FIVE

NOP
NOP
NOP
NOP

	INCF	PCLATH
	GOTO	FONT02B


	FONT02_ZERO
			MOVFW	BTCOUNT
			ADDWF	PCL,F
	
			DT	B'11000000',B'11111111'
			DT	B'10000000',B'01111111'
			DT	B'00011110',B'00111111'
			DT	B'00111111',B'00111111'
			DT	B'00111111',B'00111111'
			DT	B'00111111',B'00111111'
			DT	B'00111111',B'00111111'
			DT	B'00111111',B'00111111';
			DT	B'00111111',B'00111111';
			DT	B'00111111',B'00111111'
			DT	B'00111111',B'00111111'
			DT	B'00111111',B'00111111'
			DT	B'00111111',B'00111111'
			DT	B'00011110',B'00111111'
			DT	B'10000000',B'01111111'
			DT	B'11000000',B'11111111'

	FONT02_ONE
			MOVFW	BTCOUNT
			ADDWF	PCL

			;DT	.12,.12
			DT	B'11100111',B'11111111'
			DT	B'11100111',B'11111111'
			DT	B'11000111',B'11111111'
			DT	B'10000111',B'11111111'
			DT	B'00100111',B'11111111'
			DT	B'11100111',B'11111111'
			DT	B'11100111',B'11111111'
			DT	B'11100111',B'11111111';
			DT	B'11100111',B'11111111';
			DT	B'11100111',B'11111111'
			DT	B'11100111',B'11111111'
			DT	B'11100111',B'11111111'
			DT	B'11100111',B'11111111'
			DT	B'11100111',B'11111111'
			DT	B'00000000',B'11111111'
			DT	B'00000000',B'11111111'	

	FONT02_TWO
			MOVFW	BTCOUNT
			ADDWF	PCL,F
			
			;DT	.12
			DT	B'11000000',B'11111111'
			DT	B'10000000',B'01111111'
			DT	B'00111110',B'00111111'
			DT	B'11111111',B'00111111'
			DT	B'11111111',B'00111111'
			DT	B'11111111',B'00111111'
			DT	B'11111111',B'00111111'
			DT	B'11111110',B'00111111'
			DT	B'11000000',B'01111111'
			DT	B'10000000',B'11111111'
			DT	B'00011111',B'11111111'
			DT	B'00111111',B'11111111'
			DT	B'00111111',B'11111111'
			DT	B'00111111',B'00111111'
			DT	B'00000000',B'00111111'
			DT	B'00000000',B'00111111'
	
	FONT02_THREE
			MOVFW	BTCOUNT
			ADDWF	PCL

			;DT	.12
			DT	B'11000000',B'11111111'
			DT	B'10000000',B'01111111'
			DT	B'00011110',B'00111111'
			DT	B'00111111',B'00111111'
			DT	B'11111111',B'00111111'
			DT	B'11111111',B'00111111'
			DT	B'11111110',B'00111111'
			DT	B'11100000',B'01111111';
			DT	B'11100000',B'01111111';
			DT	B'11111110',B'00111111'
			DT	B'11111111',B'00111111'
			DT	B'11111111',B'00111111'
			DT	B'00111111',B'00111111'
			DT	B'00011110',B'00111111'
			DT	B'10000000',B'01111111'
			DT	B'11000000',B'11111111'
	
	FONT02_FOUR
			MOVFW	BTCOUNT
			ADDWF	PCL

			;DT	.12
			DT	B'11111111',B'10111111'
			DT	B'11111101',B'00111111'
			DT	B'11111001',B'00111111'
			DT	B'11111001',B'00111111'
			DT	B'11110011',B'00111111'
			DT	B'11100111',B'00111111'
			DT	B'11001111',B'00111111'
			DT	B'10011111',B'00111111';
			DT	B'00111111',B'00111111';
			DT	B'00111111',B'00111111'
			DT	B'00000000',B'00111111'
			DT	B'00000000',B'00111111'
			DT	B'11111111',B'00111111'
			DT	B'11111111',B'00111111'
			DT	B'11111111',B'00111111'
			DT	B'11111111',B'01111111'	

	FONT02_FIVE
			MOVFW	BTCOUNT
			ADDWF	PCL

			;DT	.12
			DT	B'00000000',B'00111111'
			DT	B'00000000',B'00111111'
			DT	B'00111111',B'00111111'
			DT	B'00111111',B'01111111'
			DT	B'00111111',B'11111111'
			DT	B'00111111',B'11111111'
			DT	B'00111111',B'11111111'
			DT	B'00000000',B'11111111';
			DT	B'00000000',B'01111111';
			DT	B'11111110',B'00111111'
			DT	B'11111111',B'00111111'
			DT	B'11111111',B'00111111'
			DT	B'00111111',B'00111111'
			DT	B'00011110',B'00111111'
			DT	B'10000000',B'01111111'
			DT	B'11000000',B'11111111'



ORG 0X900
FONT02B
			MOVLW	9
			MOVWF	PCLATH

			MOVFW	NUMBER
			ADDWF	PCL,F

				RETURN	

				RETURN

				RETURN

				RETURN

				RETURN

				RETURN
				
				GOTO	FONT02_SIX
	
				GOTO	FONT02_SEVEN
		
				GOTO	FONT02_EIGHT
		
				GOTO	FONT02_NINE
				
				RETURN	;A
				RETURN	;B


			
	FONT02_SIX
			MOVFW	BTCOUNT
			ADDWF	PCL

			;DT	.12
			DT	B'11000000',B'01111111'
			DT	B'10000000',B'00111111'
			DT	B'00011110',B'00111111'
			DT	B'00111111',B'00111111'
			DT	B'00111111',B'11111111'
			DT	B'00111111',B'11111111'
			DT	B'00011111',B'11111111'
			DT	B'00000000',B'11111111';
			DT	B'00000000',B'01111111';
			DT	B'00011110',B'00111111'
			DT	B'00111111',B'00111111'
			DT	B'00111111',B'00111111'
			DT	B'00111111',B'00111111'
			DT	B'00011110',B'00111111'
			DT	B'10000000',B'01111111'
			DT	B'11000000',B'11111111'
	
			
	FONT02_SEVEN
			MOVFW	BTCOUNT
			ADDWF	PCL

			;DT	.12
			DT	B'00000000',B'00111111'
			DT	B'00000000',B'00111111'
			DT	B'00111111',B'00111111'
			DT	B'00111111',B'00111111'
			DT	B'11111111',B'00111111'
			DT	B'11111111',B'00111111'
			DT	B'11111110',B'00111111'
			DT	B'11111100',B'01111111';
			DT	B'11111000',B'11111111';
			DT	B'11110001',B'11111111'
			DT	B'11100011',B'11111111'
			DT	B'11100111',B'11111111'
			DT	B'11100111',B'11111111'
			DT	B'11100111',B'11111111'
			DT	B'11100111',B'11111111'
			DT	B'11100111',B'11111111'	
	
	FONT02_EIGHT
			MOVFW	BTCOUNT
			ADDWF	PCL

			;DT	.12
			DT	B'11000000',B'11111111'
			DT	B'10000000',B'01111111'
			DT	B'00011110',B'00111111'
			DT	B'00111111',B'00111111'
			DT	B'00111111',B'00111111'
			DT	B'00011110',B'00111111'
			DT	B'10000000',B'01111111'
			DT	B'10000000',B'01111111';
			DT	B'00011110',B'00111111';
			DT	B'00111111',B'00111111'
			DT	B'00111111',B'00111111'
			DT	B'00111111',B'00111111'
			DT	B'00111111',B'00111111'
			DT	B'00011110',B'00111111'
			DT	B'10000000',B'01111111'
			DT	B'11000000',B'11111111'	

	FONT02_NINE
			MOVFW	BTCOUNT
			ADDWF	PCL

			;DT	.12
			DT	B'11000000',B'11111111'
			DT	B'10000000',B'01111111'
			DT	B'00011110',B'00111111'
			DT	B'00111111',B'00111111'
			DT	B'00111111',B'00111111'
			DT	B'00111111',B'00111111'
			DT	B'00011110',B'00111111'
			DT	B'10000000',B'00111111';
			DT	B'11000000',B'00111111';
			DT	B'11111110',B'00111111'
			DT	B'11111111',B'00111111'
			DT	B'11111111',B'00111111'
			DT	B'00111111',B'00111111'
			DT	B'00011110',B'00111111'
			DT	B'10000000',B'01111111'
			DT	B'11000000',B'11111111'


	ORG	0X2100				; DATA EEPROM LOCATION
	DE	1,2,3,4				; DEFINE FIRST FOUR EEPROM LOCATIONS AS 1, 2, 3, AND 4




	END                       ; DIRECTIVE 'END OF PROGRAM'

